## arch/arm/cpu/armv7/omap5/Kconfig
```kconfig
if OMAP54XX

choice
	prompt "OMAP5 board select"
	optional

config TARGET_CM_T54
	bool "CompuLab CM-T54"

config TARGET_OMAP5_UEVM
	bool "TI OMAP5 uEVM board"

config TARGET_DRA7XX_EVM
	bool "TI DRA7XX"
	select TI_I2C_BOARD_DETECT
	select PHYS_64BIT

config TARGET_AM57XX_EVM
	bool "AM57XX"
	select TI_I2C_BOARD_DETECT

config TARGET_LETUX_CORTEX15
	bool "Letux Cortex 15 SoM"

config TARGET_PYRA_LC15
	bool "Pyra Handheld with LC15 CPU"

endchoice

config SYS_SOC
	default "omap5"

source "board/compulab/cm_t54/Kconfig"
source "board/ti/omap5_uevm/Kconfig"
source "board/ti/dra7xx/Kconfig"
source "board/ti/am57xx/Kconfig"
source "board/goldelico/letux-cortex15/Kconfig"
source "board/pandora/pyra+lc15/Kconfig"

endif
```

## arch/mips/mach-jz47xx/Kconfig
```kconfig
menu "Ingenic JZ47xx platforms"
	depends on ARCH_JZ47XX

config SYS_SOC
	default "jz47xx"

config SPL_TEXT_BASE
	default 0x80000000 if ARCH_JZ47XX

config SYS_TEXT_BASE
	default 0x80100000 if ARCH_JZ47XX

config SOC_JZ4730
	bool
	select MIPS_INIT_STACK_IN_SRAM
	select SUPPORTS_CPU_MIPS32_R1
	select SUPPORTS_LITTLE_ENDIAN
	select SYS_RELOC_GD_ENV_ADDR
	select SPL_INIT_STACK_WITHOUT_MALLOC_F if SPL
	select SPL_LIBCOMMON_SUPPORT if SPL
	select SPL_LIBGENERIC_SUPPORT if SPL
	select SPL_LOADER_SUPPORT if SPL
	imply CLK
	imply CMD_DM
	imply DM_GPIO
	imply DM_MMC
	imply DM_MTD
	imply DM_SERIAL
	imply FIT
	imply MMC
	imply MTD
	imply MTD_RAW_NAND
	imply PINCTRL
	imply SPL
	imply SYS_NS16550
	imply SYSRESET
	imply SYSRESET_WATCHDOG
	imply TIMER
	help
	  Support for Ingenic JZ4730 family SoCs.

config SOC_JZ4780
	bool
	select SUPPORTS_LITTLE_ENDIAN
	select SUPPORTS_CPU_MIPS32_R1
	select SUPPORTS_CPU_MIPS32_R2
	help
	  Support for Ingenic JZ4780 family SoCs.

choice
	prompt "Board select"

config TARGET_JZ4730_ALPHA400
	bool "Skytone Alpha 400 Mini Notebook"
	select SOC_JZ4730
	select CMD_MMC if DISTRO_DEFAULTS
	select SPL_NAND_BASE if SPL
	select SPL_NAND_DRIVERS if SPL
	select SPL_NAND_SIMPLE if SPL
	select SPL_NAND_SUPPORT if SPL
	select SYS_NAND_U_BOOT_LOCATIONS
	imply DISTRO_DEFAULTS
	imply DM_ETH
	imply DM_ETH_PHY
	imply DM_GPIO
	imply DM_MMC
	imply DM_MTD
	imply DM_REGULATOR
	imply DM_REGULATOR_FIXED
	imply NET_RANDOM_ETHADDR
	help
	  Support for a MIPS subnotebook built around Ingenic JZ4730 SoC.
	  It is known by many names, including CPC400 and Letux 400, but
	  the OEM seems to be Skytone and use the "Alpha 400" designator.

config TARGET_JZ4780_CI20
	bool "Creator CI20 Reference Board"
	select SOC_JZ4780

endchoice

source "arch/mips/mach-jz47xx/jz4730/Kconfig"

source "board/skytone/alpha400/Kconfig"

source "board/imgtec/ci20/Kconfig"

endmenu
```

## arch/mips/mach-jz47xx/jz4730/Kconfig
```kconfig
if SOC_JZ4730

config SYS_DCACHE_SIZE
	default 16384

config SYS_DCACHE_LINE_SIZE
	default 32

config SYS_ICACHE_SIZE
	default 16384

config SYS_ICACHE_LINE_SIZE
	default 32

config SYS_MALLOC_F_LEN
	default 0x1000

config SPL_SIZE_LIMIT
	default 4096

config MIPS_CACHE_SETUP
	default n

config MIPS_CACHE_DISABLE
	default n

config JZ4730_SDRAM_BANK_SIZE
	int
	help
	  Megabytes per bank.

config JZ4730_SDRAM_ROW
	int
	help
	  Row address.

config JZ4730_SDRAM_COL
	int
	help
	  Column address.

config JZ4730_SDRAM_BANKS_PER_CHIP
	int
	help
	  Banks per chip.

config JZ4730_SDRAM_WIDTH
	int
	help
	  Data bus width.

config JZ4730_SDRAM_CAS
	int
	help
	  CAS latency: 2 or 3.

config JZ4730_SDRAM_TRAS
	int
	help
	  RAS# Active Time.

config JZ4730_SDRAM_RCD
	int
	help
	  RAS# to CAS# Delay.

config JZ4730_SDRAM_TPC
	int
	help
	  RAS# Precharge Time.

config JZ4730_SDRAM_TRW
	int
	help
	  Write Latency Time.

config JZ4730_SDRAM_TREF
	int
	help
	  Refresh period: 8192 refresh cycles/64ms.

config JZ4730_SDRAM_CKS
	int
	help
	  CKO Divider.

endif
```

## board/freescale/mx6sl_ntx/Kconfig
```kconfig
if TARGET_MX6SL_NTX

config SYS_BOARD
	default "mx6sl_ntx"

config SYS_VENDOR
	default "freescale"

config SYS_CONFIG_NAME
	default "mx6sl_ntx"

endif
```

## board/goldelico/Kconfig
```kconfig
source "board/goldelico/letux-beagle/Kconfig"
source "board/goldelico/letux-beagle-b1/Kconfig"
source "board/goldelico/letux-beagle-b2/Kconfig"
source "board/goldelico/letux-beagle-b4/Kconfig"
source "board/goldelico/letux-beagle-b7/Kconfig"
source "board/goldelico/letux-gta04/Kconfig"
source "board/goldelico/letux-gta04-b2/Kconfig"
source "board/goldelico/letux-gta04-b3/Kconfig"
source "board/goldelico/letux-gta04-b4/Kconfig"
source "board/goldelico/letux-gta04-b7/Kconfig"
source "board/goldelico/letux-gta04-b8/Kconfig"
```

## board/goldelico/letux-beagle-b1/Kconfig
```kconfig
if TARGET_LETUX_BEAGLE_B1

config SYS_BOARD
	default "letux-beagle-b1"

config SYS_VENDOR
	default "goldelico"

config SYS_CONFIG_NAME
	default "letux_beagleb1"

endif
```

## board/goldelico/letux-beagle-b7/Kconfig
```kconfig
if TARGET_LETUX_BEAGLE_B7

config SYS_BOARD
	default "letux-beagle-b7"

config SYS_VENDOR
	default "goldelico"

config SYS_CONFIG_NAME
	default "letux_beagleb7"

endif
```

## board/goldelico/letux-beagle/Kconfig
```kconfig
if TARGET_LETUX_BEAGLE

config SYS_BOARD
	default "letux-beagle"

config SYS_VENDOR
	default "goldelico"

config SYS_CONFIG_NAME
	default "letux_beagle"

endif
```

## board/goldelico/letux-beagleb2/Kconfig
```kconfig
if TARGET_LETUX_BEAGLE_B2

config SYS_BOARD
	default "letux-beagle-b2"

config SYS_VENDOR
	default "goldelico"

config SYS_CONFIG_NAME
	default "letux_beagleb2"

endif
```

## board/goldelico/letux-beagleb4/Kconfig
```kconfig
if TARGET_LETUX_BEAGLE_B4

config SYS_BOARD
	default "letux-beagle-b4"

config SYS_VENDOR
	default "goldelico"

config SYS_CONFIG_NAME
	default "letux_beagleb4"

endif
```

## board/goldelico/letux-cortex15/Kconfig
```kconfig
if TARGET_LETUX_CORTEX15

config SYS_BOARD
	default "letux-cortex15"

config SYS_VENDOR
	default "goldelico"

config SYS_CONFIG_NAME
	default "letux_cortex15"

config DUAL_RANK_DDR3
	bool "Dual-rank memory (4GB)"

endif
```

## board/goldelico/letux-gta04-b2/Kconfig
```kconfig
if TARGET_LETUX_GTA04_B2

config SYS_BOARD
	default "letux-gta04-b2"

config SYS_VENDOR
	default "goldelico"

config SYS_CONFIG_NAME
	default "letux_gta04b2"

endif
```

## board/goldelico/letux-gta04-b4/Kconfig
```kconfig
if TARGET_LETUX_GTA04_B4

config SYS_BOARD
	default "letux-gta04-b4"

config SYS_VENDOR
	default "goldelico"

config SYS_CONFIG_NAME
	default "letux_gta04b4"

endif
```

## board/goldelico/letux-gta04-b7/Kconfig
```kconfig
if TARGET_LETUX_GTA04_B7

config SYS_BOARD
	default "letux-gta04-b7"

config SYS_VENDOR
	default "goldelico"

config SYS_CONFIG_NAME
	default "letux_gta04b7"

endif
```

## board/goldelico/letux-gta04-b8/Kconfig
```kconfig
if TARGET_LETUX_GTA04_B8

config SYS_BOARD
	default "letux-gta04-b8"

config SYS_VENDOR
	default "goldelico"

config SYS_CONFIG_NAME
	default "letux_gta04b8"

endif
```

## board/goldelico/letux-gta04/Kconfig
```kconfig
if TARGET_LETUX_GTA04

config SYS_BOARD
	default "letux-gta04"

config SYS_VENDOR
	default "goldelico"

config SYS_CONFIG_NAME
	default "letux_gta04"

endif
```

## board/goldelico/letux-gta04b3/Kconfig
```kconfig
if TARGET_LETUX_GTA04_B3

config SYS_BOARD
	default "letux-gta04-b3"

config SYS_VENDOR
	default "goldelico"

config SYS_CONFIG_NAME
	default "letux_gta04b3"

endif
```

## board/goldelico/letux-gta15/Kconfig
```kconfig
if TARGET_GTA15

config SYS_BOARD
	default "letux-gta15"

config SYS_VENDOR
	default "goldelico"

config SYS_CONFIG_NAME
	default "letux_gta15"

config DUAL_RANK_DDR3
	bool "Dual-rank memory (4GB)"

endif
```

## board/goldelico/letux-lc15evm/Kconfig
```kconfig
if TARGET_LC15EVM

config SYS_BOARD
	default "lc15evm"

config SYS_VENDOR
	default "goldelico"

config SYS_CONFIG_NAME
	default "letux_lc15_evm"

config DUAL_RANK_DDR3
	bool "Dual-rank memory (4GB)"

endif
```

## board/pandora/pyra+lc15/Kconfig
```kconfig
if TARGET_PYRA_LC15

config SYS_BOARD
	default "pyra+lc15"

config SYS_VENDOR
	default "pandora"

config SYS_CONFIG_NAME
	default "pandora_pyra_lc15"

config DUAL_RANK_DDR3
	bool "Dual-rank memory (4GB)"

endif
```

## board/skytone/alpha400/Kconfig
```kconfig
if TARGET_JZ4730_ALPHA400

config SYS_BOARD
	default "alpha400"

config SYS_VENDOR
	default "skytone"

config SYS_CONFIG_NAME
	default "alpha400"

config DEFAULT_DEVICE_TREE
	default "alpha400"

config BUILD_TARGET
	default "u-boot-with-spl.bin" if SPL

config SYS_NAND_U_BOOT_OFFS
	default 0x20000

config NR_DRAM_BANKS
	default 16

config JZ4730_SDRAM_BANK_SIZE
	default 8

config JZ4730_SDRAM_ROW
	default 13

config JZ4730_SDRAM_COL
	default 9

config JZ4730_SDRAM_BANKS_PER_CHIP
	default 4

config JZ4730_SDRAM_WIDTH
	default 32

config JZ4730_SDRAM_CAS
	default 2

config JZ4730_SDRAM_TRAS
	default 45

config JZ4730_SDRAM_RCD
	default 20

config JZ4730_SDRAM_TPC
	default 20

config JZ4730_SDRAM_TRW
	default 7

config JZ4730_SDRAM_TREF
	default 7812

config JZ4730_SDRAM_CKS
	default 64

endif
```

## configs/alpha400_nand_defconfig
```kconfig
CONFIG_MIPS=y
CONFIG_ARCH_JZ47XX=y
# CONFIG_CMD_FLASH is not set
CONFIG_CMD_JFFS2=y
CONFIG_MTDIDS_DEFAULT="nand0=jz4730-nand.0"
CONFIG_MTDPARTS_DEFAULT="mtdparts=jz4730-nand.0:1m(bootloader),3m(kernel),1m(mac),5m(mini),1014m(yaffs2),-(extend)"
# CONFIG_SPL_DOS_PARTITION is not set
# CONFIG_EFI_PARTITION is not set
# CONFIG_MMC_HW_PARTITIONING is not set
CONFIG_NS16550_DYNAMIC=y
CONFIG_WATCHDOG_TIMEOUT_MSECS=0
```

## configs/letux_cortex15_defconfig
```kconfig
CONFIG_ARM=y
CONFIG_OMAP54XX=y
CONFIG_TARGET_LETUX_CORTEX15=y
CONFIG_SPL=y
# CONFIG_CMD_IMLS is not set
# CONFIG_CMD_FLASH is not set
# CONFIG_CMD_SETEXPR is not set
# CONFIG_SYS_MALLOC_CLEAR_ON_INIT is not set - reduces malloc init power peak by memset
CONFIG_CMD_MEMTEST=y
CONFIG_CMD_TCA642X=n
```

## configs/mx6sl_ntx_lpddr2_512m_defconfig
```kconfig
CONFIG_SYS_EXTRA_OPTIONS="IMX_CONFIG=board/freescale/mx6sl_ntx/imximage_lpddr2_512M.cfg,LPDDR2_512M"
CONFIG_ARM=y
CONFIG_ARCH_MX6=y
CONFIG_TARGET_MX6SL_NTX=y
CONFIG_CMD_GPIO=y
CONFIG_SYS_PROMPT="eBR-1A # "
```

## configs/pandora_pyra_lc15_defconfig
```kconfig
CONFIG_ARM=y
CONFIG_OMAP54XX=y
CONFIG_TARGET_PYRA_LC15=y
CONFIG_SPL=y
# CONFIG_CMD_IMLS is not set
# CONFIG_CMD_FLASH is not set
# CONFIG_CMD_SETEXPR is not set
# CONFIG_SYS_MALLOC_CLEAR_ON_INIT is not set - reduces malloc init power peak by memset
CONFIG_CMD_MEMTEST=y
CONFIG_CMD_TCA642X=y
```
